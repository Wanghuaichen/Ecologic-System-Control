#include"interrupt.h"
/////*******************************************************************************
//* 函 数 名         : Int1Init()
//* 函数功能		 		 : 设置外部中断1
//* 输    入         : 无
//* 输    出         : 无
//*******************************************************************************/
////void Int0Init()
////{
////	//设置INT0
////	IT0=1;		//跳变沿出发方式（下降沿）
////	EX0=1;		//打开INT0的中断允许。	
////	EA=1;			//打开总中断	
////}

/*******************************************************************************
* 函 数 名         : Timer0Init
* 函数功能		     : 定时器0初始化
* 输    入         : 无
* 输    出         : 无
* 定时时间计算		 ：初值=0XFFFF-计数值+1
*******************************************************************************/
void Timer0Init()
{
	TMOD|=0X01;	//选择为定时器0模式，工作方式1，仅用TR0打开启动。

	TH0=0Xff;		//给定时器赋初值，定时1ms
	TL0=0Xb0;	
	ET0=1;			//打开定时器0中断允许
	EA=1;				//打开总中断
	TR0=1;			//打开定时器			
}

/*******************************************************************************
* 函 数 名         : Int1Init()
* 函数功能		   : 设置外部中断1
* 输    入         : 无
* 输    出         : 无
*******************************************************************************/
////void Int1Init()
////{
////	//设置INT1
////	IT1=1;		//跳变沿出发方式（下降沿）
////	EX1=1;		//打开INT1的中断允许。	
////	EA=1;			//打开总中断	
////}

/*******************************************************************************
* 函 数 名         : Timer1Init
* 函数功能		   	 : 定时器1初始化
* 输    入         : 无
* 输    出         : 无
*******************************************************************************/
////void Timer1Init()
////{
////	TMOD|=0X10;		//选择为定时器1模式，工作方式1，仅用TR1打开启动。
////	TH1=0XFC;			//给定时器赋初值，定时1ms
////	TL1=0X18;	
////	ET1=1;				//打开定时器1中断允许
////	EA=1;					//打开总中断
////	TR1=1;				//打开定时器			
////}

/*******************************************************************************
* 函数名         :UsartInit()
* 函数功能		   :设置串口
* 输入           : 无
* 输出         	 : 无
*******************************************************************************/
////void UsartInit()
////{
////	SCON=0X50;			//设置为工作方式1
////	TMOD=0X20;			//设置计数器工作方式2
////	PCON=0X80;			//波特率加倍
////	TH1=0XF3;				//计数器初始值设置，注意波特率是4800的
////	TL1=0XF3;
////	ES=1;						//打开接收中断
////	EA=1;						//打开总中断
////	TR1=1;					//打开计数器
////}
 
/*******************************************************************************
* 函 数 名         : Int0()	interrupt 0
* 函数功能		 		 : 外部中断0的中断函数
* 输    入         : 无
* 输    出         : 无
*******************************************************************************/
////void Int0()	interrupt 0		//外部中断0的中断函数
////{
////
////
////
////}

/*******************************************************************************
* 函 数 名         : void Timer0() interrupt 1
* 函数功能		   	 : 定时器0中断函数
* 输    入         : 无
* 输    出         : 无
*******************************************************************************/
void Timer0() interrupt 1
{
	extern int led_num;
	extern int count_num;
	extern int key_ok_flag;
	extern int function_choose_flag;
	extern int led_replay;
	extern int pwm_num;

//	TH0=0XFC;		//给定时器赋初值，定时1ms
//	TL0=0X18;

	TH0=0xff;    //给定时器赋初值，定时80us
	TL0=0xb0;

	 if(key_ok_flag==1&&function_choose_flag==1)
	{
		count_num++;
	}

	if(led_replay==10)
	{	
		led_num++;
	}
	
	if(function_choose_flag==3)
	{
		pwm_num++;
	}
}

/*******************************************************************************
* 函 数 名         : Int1()	interrupt 2
* 函数功能				 : 外部中断0的中断函数
* 输    入         : 无
* 输    出         : 无
*******************************************************************************/
////void Int1()	interrupt 2		//外部中断1的中断函数
////{
////
////}

/*******************************************************************************
* 函 数 名         : void Timer1() interrupt 3
* 函数功能		   : 定时器0中断函数
* 输    入         : 无
* 输    出         : 无
*******************************************************************************/
////void Timer1() interrupt 3
////{  	
//////	extern int count_num;
////	TH1=0XFC;			//给定时器赋初值，定时1ms
////	TL1=0X18;
//////	count_num++;
////}

/*******************************************************************************
* 函数名         : Usart() interrupt 4
* 函数功能		  : 串口通信中断函数
* 输入           : 无
* 输出         	 : 无
*******************************************************************************/
//void Usart() interrupt 4
//{
//	u8 receiveData;
//	receiveData=SBUF;		//出去接收到的数据
//	RI = 0;							//清除接收中断标志位
//	SBUF=receiveData;		//将接收到的数据放入到发送寄存器
//	while(!TI);			 		//等待发送数据完成
//	TI=0;						 		//清除发送完成标志位
//}